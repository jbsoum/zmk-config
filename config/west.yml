## config/west.yml
```yaml
manifest:
  remotes:
    #- name: zmkfirmware
    #  url-base: https://github.com/zmkfirmware
    - name: petejohanson
      url-base: https://github.com/petejohanson
    #- name: infused-kim
    #  url-base: https://github.com/infused-kim
  projects:
    - name: zmk
      remote: petejohanson
      revision: shields/kyria-rev3
      import: app/west.yml
    #- name: zmk
    #  remote: infused-kim
    # revision: my-changes/oled-ext-pwr
    #  clone-depth: 1
    # import: app/west.yml
  self:
    path: config
```
